## config/west.yml
```yaml
manifest:
  remotes:
    - name: zmkfirmware
      url-base: https://github.com/zmkfirmware
    - name: caksoylar
      url-base: https://github.com/caksoylar
    - name: kot149
      url-base: https://github.com/kot149
  projects:
    - name: zmk
      remote: zmkfirmware
      revision: 773dec58eaacaef4703b3e4595e50bd71f6cad3d  # confirmed on 2026-06-08 (branch main head)
      import: app/west.yml
    - name: zmk-rgbled-widget
      remote: caksoylar
      revision: 9cef5af88c26e4b86a2a448160055dc740c14d6f  # confirmed on 2026-06-08 (branch main head)
    - name: zmk-mouse-gesture
      remote: kot149
      revision: 855a6e80f18f4b19ea2181648ac062ec72876ece  # confirmed on 2026-06-08 (branch v1 head)
  self:
    path: config
```
